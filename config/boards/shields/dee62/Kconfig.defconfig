## config/boards/shields/dee62/Kconfig.defconfig
```kconfig
if SHIELD_DEE62_LEFT

config ZMK_KEYBOARD_NAME
  default "Dee62"

config ZMK_SPLIT_ROLE_CENTRAL_DEVICE
  bool "Dee62 Left"
  default y

config ZMK_SPLIT_BLE_ROLE_CENTRAL
  bool "Dee62 Left"
	default y

endif

if SHIELD_DEE62_LEFT || SHIELD_DEE62_RIGHT

config ZMK_SPLIT
  bool "Dee62"
  default y

config ZMK_BATTERY
  default y

config ZMK_BLE
	default y

config ZMK_USB
	default y

endif
```

## config/boards/shields/dee62/Kconfig.shield
```kconfig
config SHIELD_DEE62_LEFT
    def_bool $(shields_list_contains,dee62_left)

config SHIELD_DEE62_RIGHT
    def_bool $(shields_list_contains,dee62_right)
```
